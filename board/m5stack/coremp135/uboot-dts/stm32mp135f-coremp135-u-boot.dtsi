// SPDX-License-Identifier: GPL-2.0-or-later OR BSD-3-Clause
/*
 * Copyright (C) 2022, STMicroelectronics - All Rights Reserved
 */

#include "stm32mp13-u-boot.dtsi"

/ {
	aliases {
		mmc0 = &sdmmc1;
		usb0 = &usbotg_hs;
	};

	config {
		u-boot,mmc-env-partition = "u-boot-env";
	};
};

